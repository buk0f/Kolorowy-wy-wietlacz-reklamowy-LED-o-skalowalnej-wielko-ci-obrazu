
.global main
.global __do_copy_data

	ColorDiv = 0x20
					
					
					

; aliases for IO registers:

	PORTB 	= 0x05 			
	DDRB 	= 0x04 			
	PINB 	= 0x03
	PORTC 	= 0x08			
	DDRC	= 0x07			
	PORTD	= 0x0B			
	DDRD	= 0x0A			
	SPCR 	= 0x2C 			
	SPSR	= 0x2D			
	SPDR 	= 0x2E 			
	
; initial image loaded to RAM
.section .data
red:
.byte 0xFF, 0xFF, 0xFF, 0xFF, 0x00, 0x00, 0x00, 0x00, 0x00, 0xFF, 0xFF, 0xFF, 0xFF, 0xFF, 0x00, 0x00
.byte 0xFF, 0xFF, 0xFF, 0xFF, 0x00, 0x00, 0x00, 0x00, 0x00, 0xFF, 0xFF, 0xFF, 0xFF, 0xFF, 0x00, 0x00
.byte 0xFF, 0xFF, 0xFF, 0xFF, 0x00, 0x00, 0x00, 0x00, 0x00, 0xFF, 0xFF, 0xFF, 0xFF, 0xFF, 0x00, 0x00
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.byte 0xFF, 0xE0, 0xD0, 0xC0, 0xB0, 0xA0, 0x90, 0x80, 0x70, 0x60, 0x50, 0x40, 0x30, 0x20, 0x10, 0x00
green:
.byte 0xFF, 0xFF, 0xFF, 0xFF, 0xFF, 0xFF, 0xFF, 0xFF, 0xFF, 0x00, 0x00, 0x00, 0x00, 0x00, 0x00, 0x00
.byte 0xFF, 0xFF, 0xFF, 0xFF, 0xFF, 0xFF, 0xFF, 0xFF, 0xFF, 0x00, 0x00, 0x00, 0x00, 0x00, 0x00, 0x00
.byte 0xFF, 0xFF, 0xFF, 0xFF, 0xFF, 0xFF, 0xFF, 0xFF, 0xFF, 0x00, 0x00, 0x00, 0x00, 0x00, 0x00, 0x00
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.byte 0xFF, 0xE0, 0xD0, 0xC0, 0xB0, 0xA0, 0x90, 0x80, 0x70, 0x60, 0x50, 0x40, 0x30, 0x20, 0x10, 0x00
blue:
.byte 0xFF, 0xFF, 0x00, 0x00, 0xFF, 0xFF, 0xFF, 0x00, 0x00, 0xFF, 0xFF, 0xFF, 0x00, 0x00, 0xFF, 0xFF
.byte 0xFF, 0xFF, 0x00, 0x00, 0xFF, 0xFF, 0xFF, 0x00, 0x00, 0xFF, 0xFF, 0xFF, 0x00, 0x00, 0xFF, 0xFF
.byte 0xFF, 0xFF, 0x00, 0x00, 0xFF, 0xFF, 0xFF, 0x00, 0x00, 0xFF, 0xFF, 0xFF, 0x00, 0x00, 0xFF, 0xFF
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.byte 0xFF, 0xE0, 0xD0, 0xC0, 0xB0, 0xA0, 0x90, 0x80, 0x70, 0x60, 0x50, 0x40, 0x30, 0x20, 0x10, 0x00

; end of initial image



; start of program code
.text
main:


	; spi setup
	;
	; SPI Interrupt: 	DISABLED
	; SPI: 			ENABLED
	; Data Order: 		MSB
	; Role:			SLAVE
	; Clock Polarity 	0
	; Clock Phase 		0
	; SPI Clock Rate 	N/A
	ldi 	r16, 	0b01000000 
	out 	SPCR, 	r16
	sbi 	PORTB, 	1
	
	

; loading valuse to registers for later use:

	ldi 	r16, 	0x00
	mov 	r0, 	r16
	ldi 	r16, 	0xFF
	mov 	r1, 	r16
	ldi 	r16, 	0x0F
	mov 	r2, 	r16
	ldi 	r16, 	0x08
	mov 	r3, 	r16
	ldi 	r16, 	0x01
	mov 	r4, 	r16


; initialization of registers for tracing active pixel and frame:

	mov 	r10, 	r0
	mov 	r11, 	r0 

; loading Color Divider to register r12 for use in main loop:

	ldi 	r16, 	ColorDiv
	mov 	r12, 	r16		
	
; initialize IO ports:

	ldi 	r16, 	0b00010010
	out 	DDRB, 	r16
	out 	DDRC, 	r2 		
	out 	PORTC, 	r0		
	out	DDRD,	r1		
	out 	PORTD, 	r0      	



	 	
; start of main loop:

loop:	call	showpx		
	cbi 	PORTC,  3	
	call 	delay_1us
	call 	delay_1us
	call 	delay_1us
	call 	delay_1us
	call 	delay_1us
	inc 	r10		
	brne	loop		
	add 	r11, 	r12	
	jmp	loop 		



; start of pixel displaying function

showpx: 
	ldi 	r16, 	0x0F
	out 	PORTC, 	r16		
	out 	DDRC, 	r16 		


; error corrention
	mov 	r16, 	r10
	mov 	r17, 	r16
	andi 	r16, 	0b10001000
	andi 	r17, 	0b01110111
	swap 	r16
	or 	r16, 	r17
	out	PORTD, 	r16 	

; moving active pixel index lower half of Z register for addressing RAM 
; register Z is 16bit by connecting registers ZL (r30) and ZH (r31) 
	mov 	ZL, 	r10
	

; setting color red

	ldi 	ZH, 	0x01 	
	ld 	r16, 	Z	
	cp	r11, 	r16 	
				
 	brcc	skip_r 		
	cbi	PORTC, 	0	
skip_r:

; setting color green

	ldi 	ZH, 	0x02	
	ld 	r16, 	Z       
	cp	r11, 	r16     
                                
	brcc	skip_g 		
	cbi	PORTC, 	1	
skip_g:

; setting color blue

	ldi 	ZH, 	0x03 	
	ld 	r16, 	Z       
	cp	r11, 	r16     
                                
	brcc	skip_b 		
	cbi	PORTC, 	2	
skip_b:

	sbic 	PINB, 	2
	ret			
	jmp 	SPI_Handler
	ret




SPI_Handler:
	
	ldi 	XH, 	0x01
	ldi 	XL, 	0x00
load_start:
	in 	r17, 	SPSR
	sbrs 	r17, 	7
	rjmp 	load_start
	in 	r16, 	SPDR
	
	st 	X+, 	r16
	
	cpi 	XH, 	0x04
	brne 	load_start	
skip:	
	sbis 	PINB, 	2
	rjmp 	skip
	ret

delay_1us:
	nop
	nop
	nop
	nop
	ret
delay_10us:
	call delay_1us
	call delay_1us
	call delay_1us
	call delay_1us
	call delay_1us
	call delay_1us
	call delay_1us
	call delay_1us
	call delay_1us
	call delay_1us
	ret
delay_100us:
	call delay_10us
	call delay_10us
	call delay_10us
	call delay_10us
	call delay_10us
	call delay_10us
	call delay_10us
	call delay_10us
	call delay_10us
	call delay_10us
	ret
delay_1ms:
	call delay_100us
	call delay_100us
	call delay_100us
	call delay_100us
	call delay_100us
	call delay_100us
	call delay_100us
	call delay_100us
	call delay_100us
	call delay_100us
	ret
delay_10ms:
	call delay_1ms
	call delay_1ms
	call delay_1ms
	call delay_1ms
	call delay_1ms
	call delay_1ms
	call delay_1ms
	call delay_1ms
	call delay_1ms
	call delay_1ms
	ret
delay_100ms:
	call delay_10ms
	call delay_10ms
	call delay_10ms
	call delay_10ms
	call delay_10ms
	call delay_10ms
	call delay_10ms
	call delay_10ms
	call delay_10ms
	call delay_10ms
	ret
delay_1s:
	call delay_100ms
	call delay_100ms
	call delay_100ms
	call delay_100ms
	call delay_100ms
	call delay_100ms
	call delay_100ms
	call delay_100ms
	call delay_100ms
	call delay_100ms
	ret
